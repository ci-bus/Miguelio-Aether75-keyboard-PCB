## zmk/ansi/aether75/Kconfig.board
```kconfig
# Copyright (c) 2025 Miguelio
# SPDX-License-Identifier: MIT

config BOARD_AETHER75
    bool "aether75"
    depends on SOC_NRF52840_QIAA
```

## zmk/ansi/aether75/Kconfig.defconfig
```kconfig
# Copyright (c) 2025 Miguelio
# SPDX-License-Identifier: MIT

if BOARD_AETHER75

config ZMK_KEYBOARD_NAME
    default "aether75"

if USB_DEVICE_STACK

config USB_NRFX
    default y

endif # USB_DEVICE_STACK

config BT_CTLR
    default BT

endif # BOARD_AETHER75
```

## zmk/ansi/aether75/aether75_defconfig
```kconfig
# Copyright (c) 2025 Miguelio
# SPDX-License-Identifier: MIT

CONFIG_ZMK_KEYBOARD_NAME="Aether75"

CONFIG_SOC_SERIES_NRF52X=y
CONFIG_SOC_NRF52840_QIAA=y
CONFIG_BOARD_AETHER75=y

# Enable MPU
CONFIG_ARM_MPU=y

CONFIG_PINCTRL=y

# enable GPIO
CONFIG_GPIO=y

CONFIG_USE_DT_CODE_PARTITION=y
CONFIG_BUILD_OUTPUT_UF2=y

CONFIG_MPU_ALLOW_FLASH_WRITE=y
CONFIG_NVS=y
CONFIG_SETTINGS_NVS=y
CONFIG_FLASH=y
CONFIG_FLASH_PAGE_LAYOUT=y
CONFIG_FLASH_MAP=y

CONFIG_CLOCK_CONTROL_NRF=y
CONFIG_CLOCK_CONTROL_NRF_K32SRC_RC=y

CONFIG_ZMK_RGB_UNDERGLOW=y
CONFIG_WS2812_STRIP=y

CONFIG_ZMK_RGB_UNDERGLOW_EFF_START=3

CONFIG_ZMK_KSCAN_DEBOUNCE_PRESS_MS=0
CONFIG_ZMK_KSCAN_DEBOUNCE_RELEASE_MS=15

CONFIG_BT_CTLR_TX_PWR_PLUS_8=y
CONFIG_ZMK_HID_CONSUMER_REPORT_USAGES_BASIC=y
CONFIG_BT_GATT_ENFORCE_SUBSCRIPTION=n

CONFIG_ZMK_SLEEP=y
CONFIG_ZMK_IDLE_SLEEP_TIMEOUT=60000

CONFIG_ZMK_USB=y
CONFIG_ZMK_BLE=y
CONFIG_BT_MAX_CONN=1
# CONFIG_BT_BAS=n
CONFIG_BT_MAX_PAIRED=1

CONFIG_ZMK_USB_LOGGING=n
CONFIG_ZMK_RTT_LOGGING=n

CONFIG_ZMK_STUDIO=y
CONFIG_ZMK_STUDIO_LOCKING=n

# encoder
CONFIG_EC11=y
CONFIG_EC11_TRIGGER_GLOBAL_THREAD=y
```
